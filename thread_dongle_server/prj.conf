## CMakeLists.txt
```
#
# Copyright (c) 2020 Nordic Semiconductor ASA
#
# SPDX-License-Identifier: LicenseRef-Nordic-5-Clause
#

cmake_minimum_required(VERSION 3.20.0)

find_package(Zephyr REQUIRED HINTS $ENV{ZEPHYR_BASE})

project(thread_dongle_server)

FILE(GLOB app_sources src/*.c)
# NORDIC SDK APP START
target_sources(app PRIVATE ${app_sources})

target_include_directories(app PRIVATE interface)
# NORDIC SDK APP END
```

## prj.conf
```kconfig
#
# Copyright (c) 2020 Nordic Semiconductor
#
# SPDX-License-Identifier: LicenseRef-Nordic-5-Clause
#

# nRF board library
CONFIG_DK_LIBRARY=y 

# Enable OpenThread CoAP support API
CONFIG_OPENTHREAD_COAP=y 

# Network shell
CONFIG_SHELL=y
CONFIG_OPENTHREAD_SHELL=y
CONFIG_SHELL_ARGC_MAX=26
CONFIG_SHELL_CMD_BUFF_SIZE=416

# Network sockets
CONFIG_NET_SOCKETS=y
CONFIG_NET_SOCKETS_POSIX_NAMES=y
CONFIG_NET_SOCKETS_POLL_MAX=4

# Same network Master Key for client and server
CONFIG_OPENTHREAD_NETWORKKEY="00:11:22:33:44:55:66:77:88:99:aa:bb:cc:dd:ee:ff"

# L2 OpenThread enabling
CONFIG_NET_L2_OPENTHREAD=y

# Generic networking options
CONFIG_NETWORKING=y

CONFIG_MBEDTLS_SHA1_C=n
CONFIG_FPU=y

# UART conf
CONFIG_SERIAL=y
CONFIG_UART_ASYNC_API=y
CONFIG_UART_0_ASYNC=y
CONFIG_UART_0_INTERRUPT_DRIVEN=n
CONFIG_NRFX_UARTE0=y
```

## src/coap_server.c
```c
/*
 * Copyright (c) 2020 Nordic Semiconductor ASA
 * Copyright (c) 2016-2023 Makerdiary
 *
 * SPDX-License-Identifier: LicenseRef-Nordic-5-Clause
 */

#include <zephyr/kernel.h>
#include <dk_buttons_and_leds.h>
#include <zephyr/logging/log.h>
#include <zephyr/net/openthread.h>
#include <openthread/thread.h>
#include <zephyr/sys/printk.h>
#include <zephyr/drivers/uart.h>

#include "ot_coap_utils.h"

#define LED_ON_TIME_MS 250

// UART variables
#define SLEEP_TIME_MS   100
#define UART_RECEIVE_TIMEOUT 500000
#define START_CHAR '~'
#define END_CHAR '#'

const struct device *uart= DEVICE_DT_GET(DT_NODELABEL(uart0));
static uint8_t rx_buf[MSG_BUFF_SIZE] = {0};
static uint8_t rx_msg_buf[MSG_MAX_SIZE] = {0};
static uint8_t rx_offset=0;


/* Process received char from UART */
static void process_received_char(char received_char)
{
	if(received_char == START_CHAR){
		// Empty msg buffer
		for( int i =0; i < MSG_MAX_SIZE; i++ ){
			rx_msg_buf[i] = NULL;
        }
		rx_offset = 0;
		return;
	}
	if(received_char == END_CHAR){
		printk("UART [DEBBUG] : Received message:");
		for( int i =0; i < rx_offset; i++ ){
			printk("%c", rx_msg_buf[i]);
        }
		printk("\r\n");

        // Check if wifi in message received
        char* wifi_in_msg = strchr(rx_msg_buf, 'w');
        if(*wifi_in_msg != NULL){
            const char wifi_status_char = (char)wifi_in_msg[5];
            const bool new_wifi_status = wifi_status_char == '1' ? true : false;
            set_wifi_status(new_wifi_status);
        }
        
        // Check if presence in message received
        char* presence_in_msg = strchr(rx_msg_buf, 'p');
        if(*presence_in_msg != NULL){
            const char presence_status_char = (char)presence_in_msg[4];
            const bool new_presence_status = presence_status_char == '1' ? true : false;
            set_presence_status(new_presence_status);                
        }  

        // Check if electrical in message received
        char* ele_in_msg = strchr(rx_msg_buf, 'e');
        if(*ele_in_msg != NULL){
            const char ele_status_char = (char)ele_in_msg[4];
            const bool new_ele_status = ele_status_char == '1' ? true : false;
            set_electrical_status(new_ele_status);
        }

        // Check if oulet in message received
        char* outlet_in_msg = strchr(rx_msg_buf, 'o');
        if(*outlet_in_msg != NULL){
            const char r1_status_char = (char)outlet_in_msg[7];
            const char r2_status_char = (char)outlet_in_msg[8];
            const char r3_status_char = (char)outlet_in_msg[9];
            const char r4_status_char = (char)outlet_in_msg[10];

            const bool new_r1_status = r1_status_char == '1' ? true : false;
            const bool new_r2_status = r2_status_char == '1' ? true : false;
            const bool new_r3_status = r3_status_char == '1' ? true : false;
            const bool new_r4_status = r4_status_char == '1' ? true : false;
            set_power_strip_status(new_r1_status, new_r2_status, new_r3_status, new_r4_status);
        }

		return;
	}
	else{
		rx_msg_buf[rx_offset]=received_char;
		rx_offset ++;
		return;
	}
} 


/*Callback for uart messages reception*/
static void on_uart_message(const struct device *uart_dev, struct uart_event *evt, void *user_data)
{   
	switch (evt->type) {				
	case UART_RX_RDY:
        for( int i =0; i < evt->data.rx.len; i++ ){
			process_received_char(evt->data.rx.buf[evt->data.rx.offset + i]);
        }
		break;		
	case UART_RX_DISABLED:
		uart_rx_enable(uart_dev, rx_buf, sizeof(rx_buf), UART_RECEIVE_TIMEOUT);
		break;
	default:
		break;
	}
}

// Callback for commands topic
static void on_commands_request(uint8_t* msg_buf, uint8_t msg_len)
{

    printk("THREAD [DEBBUG]: Commands msg received: ");
    for( int i =0; i < msg_len; i++ ){
         printk("%c", msg_buf[i]);
    }
    printk("\r\n");
    dk_set_led_on(COMMANDS_MSG_LED);
    k_msleep(LED_ON_TIME_MS);
    dk_set_led_off(COMMANDS_MSG_LED);    

    int ret = uart_tx(uart, msg_buf, msg_len, SYS_FOREVER_MS);
    printk("UART [DEBBUG]: Sending message via UART\r\n");
    if (ret) {
        printk("UART [ERROR]: Impossible to send message over UART\r\n");
        return 1;
    }
}

// Callback for ressources status topic
static void on_ressource_status_request()
{
    dk_set_led_on(RESSOURCES_STATUS_MSG_LED);
    k_msleep(LED_ON_TIME_MS);
    dk_set_led_off(RESSOURCES_STATUS_MSG_LED);    
}

// Callback for wifi topic
static void on_wifi_status_request()
{
    dk_set_led_on(RESSOURCES_STATUS_MSG_LED);
    k_msleep(LED_ON_TIME_MS);
    dk_set_led_off(RESSOURCES_STATUS_MSG_LED);    
}

// Callback for presence topic
static void on_presence_status_request()
{
    dk_set_led_on(RESSOURCES_STATUS_MSG_LED);
    k_msleep(LED_ON_TIME_MS);
    dk_set_led_off(RESSOURCES_STATUS_MSG_LED);    
}

// Callback for electrical topic
static void on_electrical_status_request()
{
    dk_set_led_on(RESSOURCES_STATUS_MSG_LED);
    k_msleep(LED_ON_TIME_MS);
    dk_set_led_off(RESSOURCES_STATUS_MSG_LED);    
}

// Callback for power strip topic
static void on_power_strip_status_request()
{
    dk_set_led_on(RESSOURCES_STATUS_MSG_LED);
    k_msleep(LED_ON_TIME_MS);
    dk_set_led_off(RESSOURCES_STATUS_MSG_LED);    
}

//Callback for button press
static void on_button_changed(uint32_t button_state, uint32_t has_changed)
{
    // TODO: What to do if button pressed ???
    uint32_t buttons = button_state & has_changed;
    if (buttons & DK_BTN1_MSK){      
        // switch_wifi_status();
        // switch_presence_status();
        // switch_electrical_status();
        //switch_power_strip_status();
        print_ressources_status();
    }    
}

static void on_thread_state_changed(otChangedFlags flags, struct openthread_context *ot_context,
                    void *user_data)
{
    if (flags & OT_CHANGED_THREAD_ROLE) {
        switch (otThreadGetDeviceRole(ot_context->instance)) {
        case OT_DEVICE_ROLE_CHILD:
        case OT_DEVICE_ROLE_ROUTER:
        case OT_DEVICE_ROLE_LEADER:
            dk_set_led_on(OT_CONNECTION_LED);
            break;

        case OT_DEVICE_ROLE_DISABLED:
        case OT_DEVICE_ROLE_DETACHED:
        default:
            dk_set_led_off(OT_CONNECTION_LED);
            break;
        }
    }
}

static struct openthread_state_changed_cb ot_state_chaged_cb = { .state_changed_cb =
                                     on_thread_state_changed };

int main(void)
{   int ret;

    ret = ot_coap_init(
        &on_ressource_status_request, 
        &on_wifi_status_request, 
        &on_presence_status_request, 
        &on_electrical_status_request, 
        &on_power_strip_status_request, 
        &on_commands_request
    );
    
    if (ret) {
        printk("SERVER [ERROR]: Could not initialize OpenThread CoAP\r\n");
        return 1;
    }

    ret = dk_leds_init();
    if (ret) {
        printk("LEDS [ERROR]: Could not initialize leds, err code: %d \r\n", ret);
        return 1;
    }

    if (!device_is_ready(uart)){
		printk("UART [ERROR]: Uart device not ready\r\n");
		return 1 ;
	}

    ret = dk_buttons_init(on_button_changed);
    if (ret) {
        printk("BUTTONS [ERROR]: Cannot init buttons\r\n");
        return 1;
    }

    openthread_state_changed_cb_register(openthread_get_default_context(), &ot_state_chaged_cb);
    openthread_start(openthread_get_default_context());

    // Structure to configure uart communication
    const struct uart_config uart_cfg = {
		.baudrate = 115200,
		.parity = UART_CFG_PARITY_NONE,
		.stop_bits = UART_CFG_STOP_BITS_1,
		.data_bits = UART_CFG_DATA_BITS_8,
		.flow_ctrl = UART_CFG_FLOW_CTRL_NONE
	};

    // Configure uart0 device
    ret = uart_configure(uart, &uart_cfg);
	if (ret == -ENOSYS) {
		return -ENOSYS;
	}	

    // Register uart callback function    
    ret = uart_callback_set(uart, on_uart_message, NULL);
    if (ret) {
        printk("UART [ERROR]: Imposible to registre callback ret=%d\r\n", ret);	
        return 1;
    } 

    // Start uart receiving reception in buffer
    uart_rx_enable(uart, rx_buf, sizeof(rx_buf), UART_RECEIVE_TIMEOUT);

    // loop forever waiting for uart messages
    while (1) {        
        k_msleep(SLEEP_TIME_MS);
    }
    return 0;
}
```

## src/ot_coap_utils.c
```c
/*
 * Copyright (c) 2020 Nordic Semiconductor ASA
 *
 * SPDX-License-Identifier: LicenseRef-Nordic-5-Clause
 */

#include <zephyr/logging/log.h>
#include <zephyr/net/net_pkt.h>
#include <zephyr/net/net_l2.h>
#include <zephyr/net/openthread.h>
#include <openthread/coap.h>
#include <openthread/ip6.h>
#include <openthread/message.h>
#include <openthread/thread.h>
#include "ot_coap_utils.h"

uint8_t msg_buf[MSG_BUFF_SIZE];
uint16_t msg_len = 0; 

struct server_context {
    struct otInstance *ot;
    ressources_status_request_callback_t on_ressources_status_request;
    wifi_status_request_callback_t on_wifi_status_request;
    presence_status_request_callback_t on_presence_status_request;
    electrical_status_request_callback_t on_eletrical_status_request;
    power_strip_status_request_callback_t on_power_strip_status_request;
    commands_request_callback_t on_commands_request;
    bool wifi_status;
    bool presence_status;
    bool electrical_status;
    bool power_strip_r1_status;
    bool power_strip_r2_status;
    bool power_strip_r3_status;
    bool power_strip_r4_status;
};

static struct server_context srv_context = {
    .ot = NULL,    
    .on_ressources_status_request = NULL,
    .on_wifi_status_request = NULL,
    .on_eletrical_status_request= NULL,
    .on_commands_request = NULL,
    .wifi_status = NULL,
    .presence_status = NULL,
    .electrical_status = NULL,
    .power_strip_r1_status = NULL,
    .power_strip_r2_status = NULL,
    .power_strip_r3_status = NULL,
    .power_strip_r4_status = NULL,
};

/**@brief Definition of CoAP resources for orchestrator status resources. */
static otCoapResource ressources_status_resource = {
    .mUriPath = RESSOURCES_URI_PATH,
    .mHandler = NULL,
    .mContext = NULL,
    .mNext = NULL,
};

/**@brief Definition of CoAP resources for wifi status resources. */
static otCoapResource wifi_status_resource = {
    .mUriPath = WIFI_URI_PATH,
    .mHandler = NULL,
    .mContext = NULL,
    .mNext = NULL,
};

/**@brief Definition of CoAP resources for presence status resources. */
static otCoapResource presence_status_resource = {
    .mUriPath = PRESENCE_URI_PATH,
    .mHandler = NULL,
    .mContext = NULL,
    .mNext = NULL,
};

/**@brief Definition of CoAP resources for electrical status resources. */
static otCoapResource electrical_status_resource = {
    .mUriPath = ELECTRIC_URI_PATH,
    .mHandler = NULL,
    .mContext = NULL,
    .mNext = NULL,
};

/**@brief Definition of CoAP resources for power_strip status resources. */
static otCoapResource power_strip_status_resource = {
    .mUriPath = POWER_STRIP_URI_PATH,
    .mHandler = NULL,
    .mContext = NULL,
    .mNext = NULL,
};

/**@brief Definition of CoAP resources for commands. */
static otCoapResource commands_resource = {
    .mUriPath = COMMANDS_URI_PATH,
    .mHandler = NULL,
    .mContext = NULL,
    .mNext = NULL,
};

void set_wifi_status(bool new_status){
    srv_context.wifi_status = new_status;
    printk("SERVER [DEBBUG]: New wifi status: %s \n\r", srv_context.wifi_status ? "true" : "false");
}
void set_presence_status(bool new_status){
    srv_context.presence_status = new_status;
    printk("SERVER [DEBBUG]: New presence status: %s \n\r", srv_context.presence_status ? "true" : "false");
}
void set_electrical_status(bool new_status){
    srv_context.electrical_status = new_status;
    printk("SERVER [DEBBUG]: New electrical status: %s \n\r", srv_context.electrical_status ? "true" : "false");
}

void set_power_strip_status(bool new_r1_status, bool new_r2_status, bool new_r3_status, bool new_r4_status){
    srv_context.power_strip_r1_status = new_r1_status;
    srv_context.power_strip_r2_status = new_r2_status;
    srv_context.power_strip_r3_status = new_r3_status;
    srv_context.power_strip_r4_status = new_r4_status;
    printk("SERVER [DEBBUG]: New power strip status R1:%d  R2:%d  R3:%d  R4:%d \n\r", srv_context.power_strip_r1_status, srv_context.power_strip_r2_status, srv_context.power_strip_r3_status, srv_context.power_strip_r4_status);
}

void print_ressources_status(void){
     printk("ORCHESTRATOR [DEBBUG]: Server ressources   ");
     printk("wifi: %s   ", srv_context.wifi_status ? "true" : "false");
     printk("presence: %s   ", srv_context.presence_status ? "true" : "false");   
     printk("electrical: %s   ", srv_context.electrical_status ? "true" : "false");  
     printk("power strip: R1:%d R2:%d R3:%d R4:%d\n\r", srv_context.power_strip_r1_status, srv_context.power_strip_r2_status, srv_context.power_strip_r3_status, srv_context.power_strip_r4_status);   
}

static otError ressources_status_response_send(otMessage *request_message,
                      const otMessageInfo *message_info)
{
    otError error = OT_ERROR_NO_BUFS;
    otMessage *response;    

    response = otCoapNewMessage(srv_context.ot, NULL);
    if (response == NULL) {
        goto end;
    }

    otCoapMessageInit(response, OT_COAP_TYPE_NON_CONFIRMABLE,
              OT_COAP_CODE_CONTENT);

    error = otCoapMessageSetToken(
        response, otCoapMessageGetToken(request_message),
        otCoapMessageGetTokenLength(request_message));
    if (error != OT_ERROR_NONE) {
        goto end;
    }

    error = otCoapMessageSetPayloadMarker(response);
    if (error != OT_ERROR_NONE) {
        goto end;
    }

    // Append wifi status to payload
    uint8_t *wifi_payload = srv_context.wifi_status ? "wifi:1" : "wifi:0";
    uint16_t wifi_payload_size = strlen(wifi_payload);
    
    // Append ressources status to payload
    uint8_t *presence_payload = srv_context.presence_status ? " prs:1" : " prs:0";
    uint16_t presence_payload_size = strlen(presence_payload);

    // Append electrical status to payload
    uint8_t *electrical_payload = srv_context.electrical_status ? " ele:1" : " ele:0";
    uint16_t electrical_payload_size = strlen(electrical_payload);

    // Append power strip status to payload  
    uint8_t power_strip_payload[] = " outlet:XXXX";
    uint8_t r1_status_payload = srv_context.power_strip_r1_status ? '1':'0';
    uint8_t r2_status_payload = srv_context.power_strip_r2_status ? '1':'0';
    uint8_t r3_status_payload = srv_context.power_strip_r3_status ? '1':'0';
    uint8_t r4_status_payload = srv_context.power_strip_r4_status ? '1':'0';
    power_strip_payload[8] = r1_status_payload;   
    power_strip_payload[9] = r2_status_payload;   
    power_strip_payload[10] = r3_status_payload;   
    power_strip_payload[11] = r4_status_payload;   
    uint16_t power_strip_payload_size = strlen(power_strip_payload);

    // Get payload size
    uint16_t payload_size = wifi_payload_size + presence_payload_size + electrical_payload_size + power_strip_payload_size + 1;
    uint8_t *payload = (uint8_t*) malloc(payload_size * sizeof(uint8_t));

    if(payload == NULL) {
        printk("THREAD [ERROR]: Error in payload memory alocation");
        error = OT_ERROR_FAILED; 
        goto end;
    }

    // Concatenate payload
    uint16_t new_index = 0;
    for(uint16_t i = 0; i < payload_size - 1; i++){
        if(i < wifi_payload_size){   
            payload[i] = wifi_payload[i];
        }
        if((i >= wifi_payload_size) && (i < wifi_payload_size + presence_payload_size)){
            new_index = i - wifi_payload_size;
            payload[i] = presence_payload[new_index];
        }
        if((i >= wifi_payload_size + presence_payload_size) && (i < wifi_payload_size + presence_payload_size + electrical_payload_size)){
            new_index = i - wifi_payload_size - presence_payload_size;
            payload[i] = electrical_payload[new_index];
        }
        if(i >= wifi_payload_size + presence_payload_size + electrical_payload_size){   
            new_index = i - wifi_payload_size - presence_payload_size - electrical_payload_size;
            payload[i] = power_strip_payload[new_index];
        }
    }

    payload[payload_size - 1 ] = '\0';
    printk("THREAD [DEBBUG]: Sending response payload: %s  payload_size: %d \n\r", payload, payload_size);

    error = otMessageAppend(response, payload, payload_size);
    if (error != OT_ERROR_NONE) {
        goto end;
    }

    error = otCoapSendResponse(srv_context.ot, response, message_info);

end:
    if (error != OT_ERROR_NONE && response != NULL) {
        otMessageFree(response);
    }

    free(payload);
    return error;
}

static void ressources_status_request_handler(void *context, otMessage *message,
                     const otMessageInfo *message_info)
{
    otError error;
    otMessageInfo msg_info;

    ARG_UNUSED(context);

    printk("THREAD [DEBBUG]: Received ressources status request\r\n");

    if ((otCoapMessageGetType(message) == OT_COAP_TYPE_NON_CONFIRMABLE) &&
        (otCoapMessageGetCode(message) == OT_COAP_CODE_GET)) {
        msg_info = *message_info;
        memset(&msg_info.mSockAddr, 0, sizeof(msg_info.mSockAddr));

        error = ressources_status_response_send(message, &msg_info);
        if (error == OT_ERROR_NONE) {
            srv_context.on_ressources_status_request();
        }
    }
}

static otError wifi_status_response_send(otMessage *request_message,
                      const otMessageInfo *message_info)
{
    otError error = OT_ERROR_NO_BUFS;
    otMessage *response;    

    response = otCoapNewMessage(srv_context.ot, NULL);
    if (response == NULL) {
        goto end;
    }

    otCoapMessageInit(response, OT_COAP_TYPE_NON_CONFIRMABLE,
              OT_COAP_CODE_CONTENT);

    error = otCoapMessageSetToken(
        response, otCoapMessageGetToken(request_message),
        otCoapMessageGetTokenLength(request_message));
    if (error != OT_ERROR_NONE) {
        goto end;
    }

    error = otCoapMessageSetPayloadMarker(response);
    if (error != OT_ERROR_NONE) {
        goto end;
    }

    // Append wifi status to payload
    uint8_t *payload = srv_context.wifi_status ? "wifi:1" : "wifi:0";
    uint16_t payload_size = strlen(payload) + 1;

    printk("THREAD [DEBBUG]: Wifi response payload: %s  payload_size: %d \n\r", payload, payload_size);

    error = otMessageAppend(response, payload, payload_size);
    if (error != OT_ERROR_NONE) {
        goto end;
    }

    error = otCoapSendResponse(srv_context.ot, response, message_info);

end:
    if (error != OT_ERROR_NONE && response != NULL) {
        otMessageFree(response);
    }

    return error;
}

static void wifi_status_request_handler(void *context, otMessage *message,
                     const otMessageInfo *message_info)
{
    otError error;
    otMessageInfo msg_info;

    ARG_UNUSED(context);

    printk("THREAD [DEBBUG]: Received wifi status request\r\n");

    if ((otCoapMessageGetType(message) == OT_COAP_TYPE_NON_CONFIRMABLE) &&
        (otCoapMessageGetCode(message) == OT_COAP_CODE_GET)) {
        msg_info = *message_info;
        memset(&msg_info.mSockAddr, 0, sizeof(msg_info.mSockAddr));

        error = wifi_status_response_send(message, &msg_info);
        if (error == OT_ERROR_NONE) {
            srv_context.on_ressources_status_request();
        }
    }
}

static otError presence_status_response_send(otMessage *request_message,
                      const otMessageInfo *message_info)
{
    otError error = OT_ERROR_NO_BUFS;
    otMessage *response;    

    response = otCoapNewMessage(srv_context.ot, NULL);
    if (response == NULL) {
        goto end;
    }

    otCoapMessageInit(response, OT_COAP_TYPE_NON_CONFIRMABLE,
              OT_COAP_CODE_CONTENT);

    error = otCoapMessageSetToken(
        response, otCoapMessageGetToken(request_message),
        otCoapMessageGetTokenLength(request_message));
    if (error != OT_ERROR_NONE) {
        goto end;
    }

    error = otCoapMessageSetPayloadMarker(response);
    if (error != OT_ERROR_NONE) {
        goto end;
    }

    // Append presence status to payload
    uint8_t *payload = srv_context.presence_status ? "prs:1" : "prs:0";
    uint16_t payload_size = strlen(payload) + 1;

    printk("THREAD [DEBBUG]: Presence response payload: %s  payload_size: %d \n\r", payload, payload_size);

    error = otMessageAppend(response, payload, payload_size);
    if (error != OT_ERROR_NONE) {
        goto end;
    }

    error = otCoapSendResponse(srv_context.ot, response, message_info);

end:
    if (error != OT_ERROR_NONE && response != NULL) {
        otMessageFree(response);
    }

    return error;
}

static void presence_status_request_handler(void *context, otMessage *message,
                     const otMessageInfo *message_info)
{
    otError error;
    otMessageInfo msg_info;

    ARG_UNUSED(context);

    printk("THREAD [DEBBUG]: Received presence status request\r\n");

    if ((otCoapMessageGetType(message) == OT_COAP_TYPE_NON_CONFIRMABLE) &&
        (otCoapMessageGetCode(message) == OT_COAP_CODE_GET)) {
        msg_info = *message_info;
        memset(&msg_info.mSockAddr, 0, sizeof(msg_info.mSockAddr));

        error = presence_status_response_send(message, &msg_info);
        if (error == OT_ERROR_NONE) {
            srv_context.on_ressources_status_request();
        }
    }
}

static otError electrical_status_response_send(otMessage *request_message,
                      const otMessageInfo *message_info)
{
    otError error = OT_ERROR_NO_BUFS;
    otMessage *response;    

    response = otCoapNewMessage(srv_context.ot, NULL);
    if (response == NULL) {
        goto end;
    }

    otCoapMessageInit(response, OT_COAP_TYPE_NON_CONFIRMABLE,
              OT_COAP_CODE_CONTENT);

    error = otCoapMessageSetToken(
        response, otCoapMessageGetToken(request_message),
        otCoapMessageGetTokenLength(request_message));
    if (error != OT_ERROR_NONE) {
        goto end;
    }

    error = otCoapMessageSetPayloadMarker(response);
    if (error != OT_ERROR_NONE) {
        goto end;
    }

    // Append electrical status to payload
    uint8_t *payload = srv_context.electrical_status ? "ele:1" : "ele:0";
    uint16_t payload_size = strlen(payload) + 1;

    printk("THREAD [DEBBUG]: Electrical response payload: %s  payload_size: %d \n\r", payload, payload_size);

    error = otMessageAppend(response, payload, payload_size);
    if (error != OT_ERROR_NONE) {
        goto end;
    }

    error = otCoapSendResponse(srv_context.ot, response, message_info);

end:
    if (error != OT_ERROR_NONE && response != NULL) {
        otMessageFree(response);
    }

    return error;
}

static void electrical_status_request_handler(void *context, otMessage *message,
                     const otMessageInfo *message_info)
{
    otError error;
    otMessageInfo msg_info;

    ARG_UNUSED(context);

    printk("THREAD [DEBBUG]: Received electrical status request\r\n");

    if ((otCoapMessageGetType(message) == OT_COAP_TYPE_NON_CONFIRMABLE) &&
        (otCoapMessageGetCode(message) == OT_COAP_CODE_GET)) {
        msg_info = *message_info;
        memset(&msg_info.mSockAddr, 0, sizeof(msg_info.mSockAddr));

        error = electrical_status_response_send(message, &msg_info);
        if (error == OT_ERROR_NONE) {
            srv_context.on_ressources_status_request();
        }
    }
}

static otError power_strip_status_response_send(otMessage *request_message,
                      const otMessageInfo *message_info)
{
    otError error = OT_ERROR_NO_BUFS;
    otMessage *response;    

    response = otCoapNewMessage(srv_context.ot, NULL);
    if (response == NULL) {
        goto end;
    }

    otCoapMessageInit(response, OT_COAP_TYPE_NON_CONFIRMABLE,
              OT_COAP_CODE_CONTENT);

    error = otCoapMessageSetToken(
        response, otCoapMessageGetToken(request_message),
        otCoapMessageGetTokenLength(request_message));
    if (error != OT_ERROR_NONE) {
        goto end;
    }

    error = otCoapMessageSetPayloadMarker(response);
    if (error != OT_ERROR_NONE) {
        goto end;
    }

    // Append power strip status to payload
    uint8_t payload[] = " outlet:XXXX";
    payload[8] = srv_context.power_strip_r1_status ? '1':'0';   
    payload[9] = srv_context.power_strip_r2_status ? '1':'0';   
    payload[10] = srv_context.power_strip_r3_status ? '1':'0';   
    payload[11] = srv_context.power_strip_r4_status ? '1':'0';   
    uint16_t payload_size = strlen(payload);    

    printk("THREAD [DEBBUG]: Power Strip response payload: %s  payload_size: %d \n\r", payload, payload_size);

    error = otMessageAppend(response, payload, payload_size);
    if (error != OT_ERROR_NONE) {
        goto end;
    }

    error = otCoapSendResponse(srv_context.ot, response, message_info);

end:
    if (error != OT_ERROR_NONE && response != NULL) {
        otMessageFree(response);
    }

    return error;
}

static void power_strip_status_request_handler(void *context, otMessage *message,
                     const otMessageInfo *message_info)
{
    otError error;
    otMessageInfo msg_info;

    ARG_UNUSED(context);

    printk("THREAD [DEBBUG]: Received power strip status request\r\n");

    if ((otCoapMessageGetType(message) == OT_COAP_TYPE_NON_CONFIRMABLE) &&
        (otCoapMessageGetCode(message) == OT_COAP_CODE_GET)) {
        msg_info = *message_info;
        memset(&msg_info.mSockAddr, 0, sizeof(msg_info.mSockAddr));

        error = power_strip_status_response_send(message, &msg_info);
        if (error == OT_ERROR_NONE) {
            srv_context.on_ressources_status_request();
        }
    }
}

static otError commands_msg_response_send(otMessage *request_message,
                      const otMessageInfo *message_info)
{
    otError error = OT_ERROR_NO_BUFS;
    otMessage *response;    

    response = otCoapNewMessage(srv_context.ot, NULL);
    if (response == NULL) {
        goto end;
    }

    otCoapMessageInit(response, OT_COAP_TYPE_NON_CONFIRMABLE,
              OT_COAP_CODE_CONTENT);

    error = otCoapMessageSetToken(
        response, otCoapMessageGetToken(request_message),
        otCoapMessageGetTokenLength(request_message));
    if (error != OT_ERROR_NONE) {
        goto end;
    }

    error = otCoapMessageSetPayloadMarker(response);
    if (error != OT_ERROR_NONE) {
        goto end;
    }

    // Append presence status to payload
    uint8_t *payload = "CMD:OK";
    uint16_t payload_size = strlen(payload) + 1;

    error = otMessageAppend(response, payload, payload_size);
    if (error != OT_ERROR_NONE) {
        goto end;
    }

    error = otCoapSendResponse(srv_context.ot, response, message_info);

end:
    if (error != OT_ERROR_NONE && response != NULL) {
        otMessageFree(response);
    }

    return error;
}

static void commands_request_handler(void *context, otMessage *message,
                  const otMessageInfo *message_info)
{

    otError error;
    otMessageInfo msg_info;

    ARG_UNUSED(context);

    printk("THREAD [DEBBUG]: Commands message received\r\n");
    ARG_UNUSED(context);   

    if (otCoapMessageGetType(message) != OT_COAP_TYPE_NON_CONFIRMABLE) {
        printk("THREAD [ERROR]: Commands handler - Unexpected type of message");
        goto end;
    }

    if (otCoapMessageGetCode(message) != OT_COAP_CODE_PUT) {
        printk("THREAD [ERROR]: Commands handler - Unexpected CoAP code");
        goto end;
    }

    msg_info = *message_info;
    memset(&msg_info.mSockAddr, 0, sizeof(msg_info.mSockAddr));

    error = commands_msg_response_send(message, &msg_info);
    if (error == OT_ERROR_NONE) {
        msg_len = otMessageRead(message, otMessageGetOffset(message), msg_buf, MSG_BUFF_SIZE);
        srv_context.on_commands_request(&msg_buf, msg_len);
    }   
end:
    return;
}

static void coap_default_handler(void *context, otMessage *message,
                 const otMessageInfo *message_info)
{
    printk("THREAD [DEBBUG]: Uncontext msg received\r\n");
    ARG_UNUSED(context);
    ARG_UNUSED(message);
    ARG_UNUSED(message_info);
}

int ot_coap_init(
    ressources_status_request_callback_t on_ressources_status_request,
    wifi_status_request_callback_t on_wifi_status_request,
    presence_status_request_callback_t on_presence_status_request,
    electrical_status_request_callback_t on_electrical_status_request,
    power_strip_status_request_callback_t on_power_strip_status_request,
    commands_request_callback_t on_commands_request  
)
{
    otError error;

    srv_context.wifi_status = false;
    srv_context.presence_status = false;
    srv_context.electrical_status = false;

    srv_context.on_ressources_status_request = on_ressources_status_request;
    srv_context.on_wifi_status_request = on_wifi_status_request;
    srv_context.on_presence_status_request = on_presence_status_request;
    srv_context.on_eletrical_status_request = on_electrical_status_request;
    srv_context.on_power_strip_status_request = on_power_strip_status_request;
    srv_context.on_commands_request = on_commands_request;    

    srv_context.ot = openthread_get_default_instance();
    if (!srv_context.ot) {
        error = OT_ERROR_FAILED;
        goto end;
    }

    ressources_status_resource.mContext = srv_context.ot;
    ressources_status_resource.mHandler = ressources_status_request_handler;

    wifi_status_resource.mContext = srv_context.ot;
    wifi_status_resource.mHandler = wifi_status_request_handler;

    presence_status_resource.mContext = srv_context.ot;
    presence_status_resource.mHandler = presence_status_request_handler;

    electrical_status_resource.mContext = srv_context.ot;
    electrical_status_resource.mHandler = electrical_status_request_handler;

    power_strip_status_resource.mContext = srv_context.ot;
    power_strip_status_resource.mHandler = power_strip_status_request_handler;

    commands_resource.mContext = srv_context.ot;
    commands_resource.mHandler = commands_request_handler;

    otCoapSetDefaultHandler(srv_context.ot, coap_default_handler, NULL);
    otCoapAddResource(srv_context.ot, &commands_resource);
    otCoapAddResource(srv_context.ot, &ressources_status_resource);
    otCoapAddResource(srv_context.ot, &wifi_status_resource);
    otCoapAddResource(srv_context.ot, &presence_status_resource);
    otCoapAddResource(srv_context.ot, &electrical_status_resource);
    otCoapAddResource(srv_context.ot, &power_strip_status_resource);

    error = otCoapStart(srv_context.ot, COAP_PORT);
    if (error != OT_ERROR_NONE) {
        goto end;
    }

end:
    return error == OT_ERROR_NONE ? 0 : 1;
}
```

## src/ot_coap_utils.h
```c
/*
 * Copyright (c) 2020 Nordic Semiconductor ASA
 *
 * SPDX-License-Identifier: LicenseRef-Nordic-5-Clause
 */

#ifndef __OT_COAP_UTILS_H__
#define __OT_COAP_UTILS_H__

#include <thread_dongle_interface.h>

/**@brief Type definition of the function used to handle commands resource msg.
 */
typedef void (*commands_request_callback_t)(uint8_t* msg_buf, uint8_t msg_len);
/**@brief Type definition of the function used to handle ressources status resource msg.
 */
typedef void (*ressources_status_request_callback_t)();
/**@brief Type definition of the function used to handle wifi status resource msg.
 */
typedef void (*wifi_status_request_callback_t)();
/**@brief Type definition of the function used to handle presence status resource msg.
 */
typedef void (*presence_status_request_callback_t)();

/**@brief Type definition of the function used to handle electrical status resource msg.
 */
typedef void (*electrical_status_request_callback_t)();

/**@brief Type definition of the function used to handle power strip status resource msg.
 */
typedef void (*power_strip_status_request_callback_t)();

int ot_coap_init(
    ressources_status_request_callback_t on_ressources_status_request, 
    wifi_status_request_callback_t on_wifi_status_request, 
    presence_status_request_callback_t on_presence_status_request,
    electrical_status_request_callback_t on_electrical_status_request, 
    power_strip_status_request_callback_t on_power_strip_status_request, 
    commands_request_callback_t on_commands_request
);

/**@brief Type definition of the function used to set wifi status resource msg.
 */
void set_wifi_status(bool new_status);
/**@brief Type definition of the function used to set presence status resource msg.
 */
void set_presence_status(bool new_status);
/**@brief Type definition of the function used to set electrical status resource msg.
 */
void set_electrical_status(bool new_status);
/**@brief Type definition of the function used to set power strip status resource msg.
 */
void set_power_strip_status(bool new_r1_status, bool new_r2_status, bool new_r3_status, bool new_r4_status);

/**@brief Type definition of the function used to print current status.
 */
void print_ressources_status();

#endif
```
